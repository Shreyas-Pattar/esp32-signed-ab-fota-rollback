/*
 * Dual-bank (A/B) FOTA with signature check, trial boot and rollback
 * ESP32, Arduino IDE. The update arrives over USB serial from fota_tool.py.
 *
 *  - Image is written to the inactive OTA slot (esp_ota_*).
 *  - Header is verified with ECDSA P-256 (public key in public_key.h),
 *    data is verified against the signed SHA-256.
 *  - Version must be newer than the running one.
 *  - New image runs on trial: health check -> confirm, otherwise roll back.
 *  - Rollback count is stored in NVS (persistent).
 *
 * Change FW_VERSION / FW_FAIL_MODE before each "Export Compiled Binary".
 */

#include <Arduino.h>
#include <Preferences.h>
#include "sdkconfig.h"
#include "esp_ota_ops.h"
#include "esp_partition.h"
#include "esp_system.h"
#include "mbedtls/sha256.h"
#include "mbedtls/pk.h"
#include "public_key.h"          // generated by: python fota_tool.py keygen

#define FW_VERSION    3          // 1 = USB-flashed base, 2 = good update, 3 = bad update
#define FW_FAIL_MODE  1          // 0 = healthy, 1 = health check fails, 2 = crashes in health check

#define CHUNK_SIZE   1024
#define MAX_SIG_LEN  80
#define MAX_TRIES    2

static Preferences prefs;

/* ------------------------------- Status ----------------------------------- */

static void Print_Status(void) {
    const esp_partition_t *run  = esp_ota_get_running_partition();
    const esp_partition_t *boot = esp_ota_get_boot_partition();
    esp_ota_img_states_t st;
    Serial.println("-------------------------------------------------------");
    Serial.printf("[STATUS] Firmware version : %d (fail mode %d)\n", FW_VERSION, FW_FAIL_MODE);
    Serial.printf("[STATUS] Running slot     : %s @ 0x%06X\n", run->label, (unsigned)run->address);
    Serial.printf("[STATUS] Boot slot        : %s @ 0x%06X\n", boot->label, (unsigned)boot->address);
    if (esp_ota_get_state_partition(run, &st) == ESP_OK) {
        Serial.printf("[STATUS] IDF image state  : %d\n", (int)st);
    } else {
        Serial.println("[STATUS] IDF image state  : n/a");
    }
    Serial.printf("[STATUS] Rollbacks so far : %u\n", (unsigned)prefs.getUInt("rollbacks", 0));
#ifdef CONFIG_APP_ROLLBACK_ENABLE
    Serial.println("[STATUS] IDF bootloader rollback: compiled in");
#else
    Serial.println("[STATUS] IDF bootloader rollback: not compiled in (app-level rollback only)");
#endif
    Serial.println("-------------------------------------------------------");
}

/* ------------------------------ Verification ------------------------------ */

// Message that was signed: version (LE) | size (LE) | SHA-256 of the image
static bool Verify_Signature(uint32_t version, uint32_t size, const uint8_t *sha,
                             const uint8_t *sig, size_t sig_len) {
    uint8_t msg[40];
    memcpy(msg, &version, 4);
    memcpy(msg + 4, &size, 4);
    memcpy(msg + 8, sha, 32);

    uint8_t digest[32];
    mbedtls_sha256(msg, sizeof(msg), digest, 0);

    mbedtls_pk_context pk;
    mbedtls_pk_init(&pk);
    int rc = mbedtls_pk_parse_public_key(&pk, (const unsigned char *)FOTA_PUBLIC_KEY_PEM,
                                         sizeof(FOTA_PUBLIC_KEY_PEM));
    bool ok = false;
    if (rc == 0) {
        ok = (mbedtls_pk_verify(&pk, MBEDTLS_MD_SHA256, digest, sizeof(digest), sig, sig_len) == 0);
    }
    mbedtls_pk_free(&pk);
    return ok;
}

/* ------------------------------ Update receiver --------------------------- */

static void Reject(const char *why) {
    Serial.write('N');
    Serial.println();
    Serial.printf("[FOTA] REJECTED: %s\n", why);
}

static void Receive_Update(void) {
    uint8_t hdr[42];   // version(4) size(4) sha256(32) sig_len(2)
    if (Serial.readBytes(hdr, sizeof(hdr)) != sizeof(hdr)) { Reject("header timeout"); return; }

    uint32_t version, size;
    uint16_t sig_len;
    memcpy(&version, hdr, 4);
    memcpy(&size, hdr + 4, 4);
    const uint8_t *sha = hdr + 8;
    memcpy(&sig_len, hdr + 40, 2);

    if (sig_len < 8 || sig_len > MAX_SIG_LEN) { Reject("bad signature length"); return; }
    uint8_t sig[MAX_SIG_LEN];
    if (Serial.readBytes(sig, sig_len) != sig_len) { Reject("signature timeout"); return; }

    if (version <= (uint32_t)FW_VERSION) {
        Reject("version is not newer than the running firmware (anti-rollback)");
        return;
    }
    if (!Verify_Signature(version, size, sha, sig, sig_len)) {
        Reject("signature INVALID - update not trusted");
        return;
    }

    const esp_partition_t *target = esp_ota_get_next_update_partition(NULL);
    if (target == NULL) { Reject("no OTA partition available"); return; }
    if (size < 4096 || size > target->size) { Reject("image size out of range"); return; }

    esp_ota_handle_t handle = 0;
    if (esp_ota_begin(target, size, &handle) != ESP_OK) { Reject("esp_ota_begin failed"); return; }

    Serial.write('K');       // header accepted, send the data
    Serial.flush();

    mbedtls_sha256_context ctx;
    mbedtls_sha256_init(&ctx);
    mbedtls_sha256_starts(&ctx, 0);

    static uint8_t buf[CHUNK_SIZE];
    uint32_t received = 0;
    while (received < size) {
        uint32_t left = size - received;
        size_t want = (left < CHUNK_SIZE) ? left : CHUNK_SIZE;
        size_t got = Serial.readBytes(buf, want);
        if (got != want) {
            esp_ota_abort(handle);
            mbedtls_sha256_free(&ctx);
            Reject("transfer timeout");
            return;
        }
        mbedtls_sha256_update(&ctx, buf, got);
        if (esp_ota_write(handle, buf, got) != ESP_OK) {
            esp_ota_abort(handle);
            mbedtls_sha256_free(&ctx);
            Reject("flash write failed");
            return;
        }
        received += got;
        Serial.write('A');   // chunk acknowledged
    }

    uint8_t calc[32];
    mbedtls_sha256_finish(&ctx, calc);
    mbedtls_sha256_free(&ctx);

    if (memcmp(calc, sha, 32) != 0) {
        esp_ota_abort(handle);
        Reject("image hash MISMATCH - data corrupted or tampered");
        return;
    }
    if (esp_ota_end(handle) != ESP_OK) { Reject("image validation failed"); return; }

    prefs.putUInt("pend", version);      // mark the candidate as "on trial"
    prefs.putUInt("tries", 0);
    if (esp_ota_set_boot_partition(target) != ESP_OK) {
        prefs.putUInt("pend", 0);
        Reject("could not set boot partition");
        return;
    }

    Serial.write('D');
    Serial.println();
    Serial.printf("[FOTA] Image v%u verified (signature + SHA-256) and written to %s. Rebooting...\n",
                  (unsigned)version, target->label);
    Serial.flush();
    delay(500);
    esp_restart();
}

/* ------------------------------ Health / rollback ------------------------- */

static bool Health_Check(void) {
    Serial.println("[HEALTH] Running self-test...");
    bool ok = true;

    uint32_t heap = ESP.getFreeHeap();
    Serial.printf("[HEALTH] free heap: %u bytes (need > 80000)\n", (unsigned)heap);
    if (heap < 80000) ok = false;

    static const uint8_t expected[32] = {
        0xba,0x78,0x16,0xbf,0x8f,0x01,0xcf,0xea,0x41,0x41,0x40,0xde,0x5d,0xae,0x22,0x23,
        0xb0,0x03,0x61,0xa3,0x96,0x17,0x7a,0x9c,0xb4,0x10,0xff,0x61,0xf2,0x00,0x15,0xad};
    uint8_t out[32];
    mbedtls_sha256((const unsigned char *)"abc", 3, out, 0);
    bool crypto_ok = (memcmp(out, expected, 32) == 0);
    Serial.printf("[HEALTH] SHA-256 self-test: %s\n", crypto_ok ? "ok" : "FAILED");
    if (!crypto_ok) ok = false;

#if FW_FAIL_MODE == 2
    Serial.println("[HEALTH] (test build) simulating a crash...");
    Serial.flush();
    abort();
#endif
#if FW_FAIL_MODE == 1
    Serial.println("[HEALTH] (test build) simulated peripheral bus timeout");
    ok = false;
#endif
    delay(500);
    return ok;
}

static void Roll_Back(const char *reason) {
    Serial.printf("[ROLLBACK] %s\n", reason);
    prefs.putUInt("tries", 0);          // 'pend' stays set so the old image can report the rollback
    Serial.println("[ROLLBACK] Switching back to the previous image...");
    Serial.flush();
    esp_ota_mark_app_invalid_rollback_and_reboot();   // returns only if unsupported / failed
    const esp_partition_t *prev = esp_ota_get_next_update_partition(NULL);
    if (prev != NULL && esp_ota_set_boot_partition(prev) == ESP_OK) {
        delay(300);
        esp_restart();
    }
    Serial.println("[ROLLBACK] FAILED to switch partition");
}

/* -------------------------------- Arduino --------------------------------- */

void setup() {
    Serial.setRxBufferSize(4096);
    Serial.begin(115200);
    Serial.setTimeout(5000);
    delay(1000);

    prefs.begin("fota", false);

    Serial.println("\n=======================================================");
    Serial.println("  Dual-Bank FOTA: signed update, trial boot, rollback");
    Serial.println("=======================================================");

    uint32_t pend = prefs.getUInt("pend", 0);
    if (pend != 0) {
        if (pend == (uint32_t)FW_VERSION) {
            uint32_t tries = prefs.getUInt("tries", 0) + 1;
            prefs.putUInt("tries", tries);
            Serial.printf("[TRIAL] Candidate v%u booted (attempt %u of %u)\n",
                          (unsigned)pend, (unsigned)tries, (unsigned)(MAX_TRIES + 1));
            if (tries > MAX_TRIES) {
                Roll_Back("candidate never confirmed (crash loop?)");
            } else if (Health_Check()) {
                prefs.putUInt("pend", 0);
                prefs.putUInt("tries", 0);
                esp_ota_mark_app_valid_cancel_rollback();
                Serial.printf("[TRIAL] v%u CONFIRMED - now the permanent image\n", (unsigned)pend);
            } else {
                Roll_Back("health check FAILED");
            }
        } else {
            uint32_t rb = prefs.getUInt("rollbacks", 0) + 1;
            prefs.putUInt("rollbacks", rb);
            prefs.putUInt("pend", 0);
            prefs.putUInt("tries", 0);
            Serial.printf("[ROLLBACK DETECTED] Candidate v%u failed. Running previous v%d. Total rollbacks: %u\n",
                          (unsigned)pend, FW_VERSION, (unsigned)rb);
        }
    }

    Print_Status();
    Serial.println("[FOTA] READY. Send an update with: python fota_tool.py send ...");
    Serial.println("       (type 's' for status)");
}

void loop() {
    static uint8_t win[4] = {0, 0, 0, 0};
    while (Serial.available()) {
        uint8_t c = Serial.read();
        win[0] = win[1]; win[1] = win[2]; win[2] = win[3]; win[3] = c;
        if (win[0] == 'F' && win[1] == 'O' && win[2] == 'T' && win[3] == 'A') {
            memset(win, 0, sizeof(win));
            Receive_Update();
        } else if (c == 's') {
            Print_Status();
        }
    }
    delay(10);
}